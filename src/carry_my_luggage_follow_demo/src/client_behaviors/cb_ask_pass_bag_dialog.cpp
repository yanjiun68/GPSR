#include "carry_my_luggage_phase1/client_behaviors/cb_ask_pass_bag_dialog.hpp"

#include "carry_my_luggage_phase1/events/ev_pass_bag_no.hpp"
#include "carry_my_luggage_phase1/events/ev_pass_bag_yes.hpp"

#include <rclcpp_action/rclcpp_action.hpp>
#include <voice_interfaces/action/receptionist.hpp>

#include <chrono>
#include <future>

using namespace std::chrono_literals;

namespace
{
constexpr auto kServerTimeout = std::chrono::seconds(10);
constexpr auto kResultTimeout = std::chrono::seconds(30);
constexpr float kRecordSec = 4.0F;
constexpr char kMicDevice[] = "plughw:CARD=sofhdadsp,DEV=6";
constexpr char kPiperModelPath[] = "/home/yanjiun68/piper_models/en_US-lessac-medium.onnx";
constexpr char kWhisperModel[] = "base";
constexpr char kWhisperLanguage[] = "en";
}  // namespace

namespace carry_my_luggage_phase1::client_behaviors
{
void CbAskPassBagDialog::onEntry()
{
  // Receptionist action section: use the standard guest-dialog action generated by voice_interfaces.
  using Receptionist = voice_interfaces::action::Receptionist;

  // ROS node section: reuse the SMACC2 node owned by this client behavior.
  auto node = getNode();

  // Action client section: call the current Receptionist server instead of the discontinued pass-bag action.
  auto client = rclcpp_action::create_client<Receptionist>(node, "/receptionist");

  // Server availability section: fail the behavior if the voice action server is not running.
  if (!client->wait_for_action_server(kServerTimeout)) {
    RCLCPP_WARN(getLogger(), "/receptionist action server is not available.");
    postFailureEvent();
    return;
  }

  // Goal setup section: run the interactive interview mode, not summary-only mode.
  Receptionist::Goal goal;
  goal.summary_only = false;
  goal.replay_last_profile = false;
  goal.mic_device = kMicDevice;
  goal.record_sec = kRecordSec;
  goal.piper_model_path = kPiperModelPath;
  goal.whisper_model = kWhisperModel;
  goal.whisper_language = kWhisperLanguage;
  goal.guest_name = "";
  goal.guest_age = 0;
  goal.guest_gender = "";
  goal.favorite_drink = "";

  // Goal options section: log action feedback for field testing and operator diagnosis.
  typename rclcpp_action::Client<Receptionist>::SendGoalOptions options;
  options.feedback_callback =
    [logger = getLogger()](
    typename rclcpp_action::ClientGoalHandle<Receptionist>::SharedPtr,
    const std::shared_ptr<const Receptionist::Feedback> feedback)
    {
      RCLCPP_INFO(
        logger, "/receptionist feedback: stage=%s info=%s final_summary=%s",
        feedback->stage.c_str(), feedback->info.c_str(), feedback->final_summary.c_str());
    };

  // Send-goal section: wait cooperatively so SMACC2 shutdown can interrupt this behavior.
  auto goal_future = client->async_send_goal(goal, options);
  while (!isShutdownRequested() && rclcpp::ok() && goal_future.wait_for(100ms) != std::future_status::ready) {
    rclcpp::sleep_for(100ms);
  }

  // Shutdown guard section: avoid posting success after ROS shutdown begins.
  if (!rclcpp::ok() || isShutdownRequested()) {
    postFailureEvent();
    return;
  }

  // Goal acceptance section: rejected goals are treated as behavior failure.
  auto goal_handle = goal_future.get();
  if (goal_handle == nullptr) {
    RCLCPP_WARN(getLogger(), "/receptionist goal was rejected.");
    postFailureEvent();
    return;
  }

  // Result wait section: bound the interaction time so the state machine cannot block forever.
  auto result_future = client->async_get_result(goal_handle);
  const auto start = std::chrono::steady_clock::now();
  while (!isShutdownRequested() && rclcpp::ok() &&
    result_future.wait_for(100ms) != std::future_status::ready)
  {
    if ((std::chrono::steady_clock::now() - start) > kResultTimeout) {
      RCLCPP_WARN(getLogger(), "/receptionist timed out.");
      postFailureEvent();
      return;
    }
    rclcpp::sleep_for(100ms);
  }

  // Shutdown guard section: do not inspect an action result after shutdown request.
  if (!rclcpp::ok() || isShutdownRequested()) {
    postFailureEvent();
    return;
  }

  // Result status section: only a succeeded ROS action can advance this behavior.
  auto result = result_future.get();
  if (result.code != rclcpp_action::ResultCode::SUCCEEDED) {
    RCLCPP_WARN(getLogger(), "/receptionist finished with non-success result.");
    postFailureEvent();
    return;
  }

  // Outcome section: handover_ok means the Receptionist final summary was delivered.
  if (result.result->handover_ok) {
    RCLCPP_INFO(getLogger(), "Receptionist guest summary delivered.");
    postEvent<events::EvPassBagYes>();
    return;
  }

  // Failure outcome section: keep the existing no-event path for state-machine compatibility.
  RCLCPP_INFO(getLogger(), "Receptionist guest summary was not delivered.");
  postEvent<events::EvPassBagNo>();
}
}  // namespace carry_my_luggage_phase1::client_behaviors
